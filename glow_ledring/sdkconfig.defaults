## glow_ledring/sdkconfig.defaults
```kconfig
# ESP32-CAM Robot Standard Configuration
# This file contains all standard settings for ESP32-CAM robot projects

# === FLASH AND SPI CONFIGURATION ===
# Serial flasher config: Flash size 4MB
CONFIG_ESPTOOLPY_FLASHSIZE_4MB=y
CONFIG_ESPTOOLPY_FLASHSIZE="4MB"

# Serial flasher config: Flash SPI speed 80MHz  
CONFIG_ESPTOOLPY_FLASHFREQ_80M=y
CONFIG_ESPTOOLPY_FLASHFREQ="80m"

# === ESP SYSTEM SETTINGS ===
# Component config -> ESP System Settings: CPU clock speed 240MHz
CONFIG_ESP_DEFAULT_CPU_FREQ_MHZ_240=y
CONFIG_ESP_DEFAULT_CPU_FREQ_MHZ=240

# Component config -> ESP System Settings: Main task stack size 32KB
# Increased from default 24KB to prevent stack overflow in get_chip_info() 
# and other functions
CONFIG_ESP_MAIN_TASK_STACK_SIZE=32768
CONFIG_MAIN_TASK_STACK_SIZE=32768

# === PSRAM CONFIGURATION ===
# Component config -> ESP PSRAM: Enable support for PSRAM
CONFIG_SPIRAM=y

# Component config -> ESP PSRAM -> SPI RAM config: Set RAM speed 80MHz
CONFIG_SPIRAM_SPEED_80M=y
CONFIG_SPIRAM_SPEED=80
```
